## Kconfig
```kconfig
#
# For a description of the syntax of this configuration file,
# see Documentation/kbuild/kconfig-language.txt.
#
mainmenu "Linux/$ARCH $KERNELVERSION Kernel Configuration"

config SRCARCH
	string
	option env="SRCARCH"

source "arch/$SRCARCH/Kconfig"

config CABLE_DETECT_8X55
boolean "Cable detect driver"
default n
help
Detect usb, ac and other accessories.

config CABLE_DETECT_ACCESSORY
boolean "CABLE ACCESSORY DETECT"
default n

config CABLE_DETECT_ACCESSORY_BY_ADC
boolean "DETECT ACCESSORY BY PMIC ADC"
default n

config GPS_1530
boolean "ENABLE GPS 1530 UART"
default n

config GPS_1530_LNA_POWER
boolean "GPS 2.7V LNA POWER"
default n
```

## drivers/i2c/chips/Kconfig
```kconfig
#
# Miscellaneous I2C chip drivers configuration
#
# *** DEPRECATED! Do not add new entries! See Makefile ***
#

menu "Miscellaneous I2C Chip support"


config SENSORS_ONLY_BMA250
	tristate "BMA250 acceleration sensor support"
	depends on I2C=y
	help
	  BMA250 ONLY G-sensor Driver implemented by HTC.

config CPLD
        tristate "CPLD"
        depends on I2C=y
        help
          CPLD.

config INPUT_CAPELLA_CM3629
        tristate "CM3629 proximity and light sensor"
        help
          Say Y here to enable the CM3629 Short Distance Proximity
          Sensor with Ambient Light Sensor.

config PSENSOR_KTHRESHOLD
        tristate "CM3629 proximity and light sensor"
        help
          Say Y here to enable the CM3629 Proximity Sensor
          set or get threshold value from emmc.


config CODEC_AIC3254
	tristate "Codec AIC3254 support"
	depends on I2C=y
	help
	  AIC3254 Driver implemented by HTC.

config WSENSOR_ENABLE
        tristate "CM3629 proximity and light sensor"
        help
          Say Y here to enable the CM3629 Short Distance Proximity
          Sensor with Ambient Light Sensor.


config TPS65200
        tristate "tps65200 Driver"
        depends on I2C
        help
         TPS65200 Switch charger implemented by HTC.
         This could enable battery driver to set
         Charging current 100mA~500mA or 500mA~1000mA
         by GPIO or Register

config SENSORS_NFC_PN544
	tristate "PN544 NFC sensor support"
	depends on I2C=y
	help
	  PN544 NFC Driver implemented.

config AMP_RT5501
        tristate "TI RT5501 AMP Driver"
        depends on I2C=y
        help
         TI RT5501 AMP Driver implemented by HTC.

config AMP_TFA9887
        tristate "NXP TFA9887 Speaker AMP Driver"
        depends on I2C=y
        help
         NXP TFA9887 Speaker AMP Driver implemented by HTC.

config AMP_TFA9887L
        tristate "NXP TFA9887L Speaker AMP Driver"
        depends on I2C=y
        help
         NXP TFA9887L Speaker AMP Driver implemented by HTC.

endmenu
```

## drivers/msm/Kconfig
```kconfig
config WLAN_AR6000
	tristate "MSM WLAN AR6000 platform driver"
	---help---
	  MSM WLAN AR6000 platform driver
```
